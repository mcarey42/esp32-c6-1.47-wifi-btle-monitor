## main/Kconfig.projbuild
```kconfig
menu "wlogger"
    config WLOGGER_FAKE_RADIOS
        bool "Use synthetic radio events instead of real Wi-Fi/BLE"
        default n

    config WLOGGER_WIFI_DWELL_MS
        int "Per-channel Wi-Fi dwell time (ms)"
        default 500

    config WLOGGER_BLE_WINDOW_MS
        int "BLE scan window per cycle (ms)"
        default 2000
endmenu
```

## sdkconfig.defaults
```kconfig
CONFIG_IDF_TARGET="esp32c6"
CONFIG_PARTITION_TABLE_CUSTOM=y
CONFIG_PARTITION_TABLE_CUSTOM_FILENAME="partitions.csv"
CONFIG_ESPTOOLPY_FLASHSIZE_4MB=y
CONFIG_ESPTOOLPY_FLASHSIZE="4MB"
CONFIG_FATFS_LFN_HEAP=y
# CONFIG_FATFS_LONG_FILENAMES=y  # unknown symbol in IDF v6.0; LFN is enabled via CONFIG_FATFS_LFN_HEAP. Re-evaluate when adding fatfs.
CONFIG_BT_ENABLED=y
CONFIG_BT_NIMBLE_ENABLED=y
CONFIG_BT_NIMBLE_ROLE_CENTRAL=n
CONFIG_BT_NIMBLE_ROLE_PERIPHERAL=n
CONFIG_BT_NIMBLE_ROLE_BROADCASTER=n
CONFIG_BT_NIMBLE_ROLE_OBSERVER=y
CONFIG_BT_NIMBLE_HOST_TASK_STACK_SIZE=4096
# LVGL 9 renamed several keys vs LVGL 8 docs:
#   LV_USE_STDLIB_MALLOC=1 / LV_MEM_CUSTOM=y -> LV_USE_CLIB_MALLOC=y (use C-lib malloc instead of LVGL builtin pool)
#   LV_USE_OS=LV_OS_FREERTOS -> LV_OS_FREERTOS=y (Kconfig choice option directly)
CONFIG_LV_USE_CLIB_MALLOC=y
CONFIG_LV_COLOR_DEPTH_16=y
CONFIG_LV_OS_FREERTOS=y
CONFIG_LV_FONT_MONTSERRAT_12=y
CONFIG_LV_FONT_MONTSERRAT_14=y
CONFIG_LV_FONT_MONTSERRAT_20=y
CONFIG_LV_FONT_MONTSERRAT_28=y
CONFIG_ESP_TASK_WDT_INIT=y
CONFIG_ESP_TASK_WDT_TIMEOUT_S=10
CONFIG_FREERTOS_HZ=1000
# Run CPU at 80 MHz (default is 160) — halves CPU power, plenty fast for our workload
CONFIG_ESP_DEFAULT_CPU_FREQ_MHZ_80=y
CONFIG_ESP_DEFAULT_CPU_FREQ_MHZ=80
# unset the default 160 MHz choice so the 80 MHz one wins
# CONFIG_ESP_DEFAULT_CPU_FREQ_MHZ_160 is not set
```
